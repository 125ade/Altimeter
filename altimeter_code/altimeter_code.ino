/*

  This is code is for BMP280 humidity, temperature & pressure sensor
  
*/
#include <cmath>
#include <Wire.h>
#include <SPI.h>
#include <Adafruit_BMP280.h>
#include <Adafruit_GFX.h>
#include <Adafruit_SSD1306.h>

#define SCREEN_WIDTH 128    // OLED display width, in pixels
#define SCREEN_HEIGHT 32    // OLED display height, in pixels
#define OLED_RESET     -1   // Reset pin # (or -1 if sharing Arduino reset pin)
#define SCREEN_ADDRESS 0x3C //< See datasheet for Address; 0x3D for 128x64, 0x3C for 128x32
#define x_si 0
#define y_row_1 0
#define y_row_2 11
#define y_row_3 22

Adafruit_SSD1306 display(SCREEN_WIDTH, SCREEN_HEIGHT, &Wire, OLED_RESET);

// 'logo_125ade_lab', 128x32px
const unsigned char epd_bitmap_logo_125ade_lab [] PROGMEM = {
	0xff, 0xff, 0xff, 0xff, 0xff, 0xff, 0xff, 0xff, 0xff, 0xff, 0xff, 0xff, 0xff, 0xff, 0xff, 0xff, 
	0xff, 0x03, 0xff, 0x00, 0x3f, 0xc0, 0x00, 0x7f, 0xe0, 0x1f, 0xf8, 0x00, 0x1f, 0xf0, 0x00, 0x01, 
	0xfe, 0x03, 0xfc, 0x00, 0x0f, 0xc0, 0x00, 0x7f, 0xe0, 0x1f, 0xf8, 0x00, 0x07, 0xf0, 0x00, 0x01, 
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	0xff, 0xff, 0xff, 0xff, 0xff, 0x7f, 0xff, 0xff, 0xff, 0xff, 0xfd, 0xff, 0xff, 0xff, 0xff, 0xff
};



Adafruit_BMP280 bmp; // use I2C interface
Adafruit_Sensor *bmp_temp = bmp.getTemperatureSensor();
Adafruit_Sensor *bmp_pressure = bmp.getPressureSensor();

const float seaLevelPressure = 1019.66; // Sea level pressure in hPa
int x_cursor_alt, x_cursor_tem, x_cursor_pre, A_check, T_check, P_check;
float A, T, P;

void setup() {
  // serial setup
  Serial.begin(9600); 

  // display setup
  if(!display.begin(SSD1306_SWITCHCAPVCC, SCREEN_ADDRESS)) {
    Serial.println(F("display allocation failed"));
    for(;;); 
  }
  
  // logo
  display.clearDisplay();
  display.display();
  display.drawBitmap(0,0, epd_bitmap_logo_125ade_lab, 128, 32, WHITE);
  display.display();
  delay(4000);
  

  
  // setup bmp280
  unsigned status;
  status = bmp.begin(0x76, BMP280_CHIPID);
  if (!status) {
    display.clearDisplay();
    display.display();
    display.setCursor(0,0);
    display.setTextSize(1);
    display.setTextColor(WHITE);
    display.print("bmp280 not found");
    display.display();
    while(!status){
      status = bmp.begin(0x76, BMP280_CHIPID);
      delay(2000);
      }
  }

  
  bmp.setSampling(Adafruit_BMP280::MODE_NORMAL,     /* Operating Mode. */
                  Adafruit_BMP280::SAMPLING_X2,     /* Temp. oversampling */
                  Adafruit_BMP280::SAMPLING_X16,    /* Pressure oversampling */
                  Adafruit_BMP280::FILTER_X16,      /* Filtering. */
                  Adafruit_BMP280::STANDBY_MS_500); /* Standby time. */

  bmp_temp->printSensorDetails();
}

void loop() {
    sensors_event_t temp_event, pressure_event;
    bmp_temp->getEvent(&temp_event);
    bmp_pressure->getEvent(&pressure_event);

    display.clearDisplay();
    T = temp_event.temperature; // Temperature in Celsius
    P = pressure_event.pressure; // Pressure in hPa
    A = 44330.0 * (1.0 - pow((P / seaLevelPressure), 0.1903));
    
    x_cursor_alt = 47;
    A_check = static_cast<int>(floor(A));
    if (A_check > 10){
      x_cursor_alt = x_cursor_alt - 6;
    }
    if (A_check > 100){
      x_cursor_alt = x_cursor_alt - 6;
    }
    if (A_check > 1000){
      x_cursor_alt = x_cursor_alt - 6;
    }

    x_cursor_pre = 47;
    P_check = static_cast<int>(floor(P));
    if (P_check > 10){
      x_cursor_pre = x_cursor_pre - 6;
    }
    if (P_check > 100){
      x_cursor_pre = x_cursor_pre - 6;
    }
    if (P_check > 1000){
      x_cursor_pre = x_cursor_pre - 6;
    }

    x_cursor_tem = 47;
    T_check = static_cast<int>(floor(T));
    if (T_check > 10){
      x_cursor_tem = x_cursor_tem - 6;
    }
    if (T_check > 100){
      x_cursor_tem = x_cursor_tem - 6;
    }
    if (T_check > 1000){
      x_cursor_tem = x_cursor_tem - 6;
    }

    display.setTextColor(WHITE);
    display.setTextSize(1);

    display.setCursor(x_si,y_row_1);
    display.print("M");
    display.setCursor(x_cursor_alt,y_row_1);
    display.print(A, 0);
       
    display.setCursor(x_si,y_row_2);
    display.print("hPa");
    display.setCursor(x_cursor_pre,y_row_2);
    display.print(P, 2); 

    display.setCursor(x_si,y_row_3);
    display.print("C");
    display.setCursor(x_cursor_tem,y_row_3);
    display.print(T, 1); 
    
    display.display();
    delay(1000);  
}
